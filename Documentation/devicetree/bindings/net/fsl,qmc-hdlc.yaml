## Documentation/devicetree/bindings/net/fsl,qmc-hdlc.yaml
```yaml
# SPDX-License-Identifier: (GPL-2.0-only OR BSD-2-Clause)
%YAML 1.2
---
$id: http://devicetree.org/schemas/net/fsl,qmc-hdlc.yaml#
$schema: http://devicetree.org/meta-schemas/core.yaml#

title: Freescale/NXP QUICC Multichannel Controller (QMC) HDLC

maintainers:
  - Herve Codina <herve.codina@bootlin.com>

description: |
  The QMC HDLC uses a QMC (QUICC Multichannel Controller) channel to transfer
  HDLC data.

properties:
  compatible:
    const: fsl,qmc-hdlc

  fsl,qmc-chan:
    $ref: /schemas/types.yaml#/definitions/phandle-array
    items:
      - items:
          - description: phandle to QMC node
          - description: Channel number
    description:
      Should be a phandle/number pair. The phandle to QMC node and the QMC
      channel to use.

  framer:
    $ref: /schemas/types.yaml#/definitions/phandle
    description:
      phandle to the framer node

required:
  - compatible
  - fsl,qmc-chan

additionalProperties: false

examples:
  - |
    hdlc {
        compatible = "fsl,qmc-hdlc";
        fsl,qmc-chan = <&qmc 16>;
    };
```

## cmpc885.its
```
/dts-v1/;

/ {
	description = "CMPC885 image";
	#address-cells = <1>;

	images {
		kernel@1 {
			description = "CMPC885 kernel";
			data = /incbin/("vmlinux.bin.gz");
			type = "kernel";
			arch = "ppc";
			os = "linux";
			compression = "gzip";
			load = <00000000>;
			entry = <00000000>;
			hash@1 {
				algo = "crc32";
			};
			hash@2 {
				algo = "sha1";
			};
		};
		fdt@1 {
			description = "CMPC885 DTB";
			data = /incbin/("arch/powerpc/boot/dts/saf3000/cmpc885.dtb");
			type = "flat_dt";
			arch = "ppc";
			compression = "none";
			hash@1 {
				algo = "crc32";
			};
			hash@2 {
				algo = "sha1";
			};
		};
		fdt@2 {
			description = "MCR3000_2G DTB";
			data = /incbin/("arch/powerpc/boot/dts/saf3000/mcr3000_2g.dtb");
			type = "flat_dt";
			arch = "ppc";
			compression = "none";
			hash@1 {
				algo = "crc32";
			};
			hash@2 {
				algo = "sha1";
			};
		};
		fdt@3 {
			description = "MIAE DTB";
			data = /incbin/("arch/powerpc/boot/dts/saf3000/miae.dtb");
			type = "flat_dt";
			arch = "ppc";
			compression = "none";
			hash@1 {
				algo = "crc32";
			};
			hash@2 {
				algo = "sha1";
			};
		};
	};

	configurations {
		default = "cmpc885";
		cmpc885 {
			description = "CMPC885 configuration";
			kernel = "kernel@1";
			fdt = "fdt@1";
		};
		mcr3k_2g {
			description = "MCR3000_2G configuration";
			kernel = "kernel@1";
			fdt = "fdt@2";
		};
		miae {
			description = "MIAE configuration";
			kernel = "kernel@1";
			fdt = "fdt@3";
		};
	};
};
```

## cmpcpro.its
```
/dts-v1/;

/ {
	description = "CMPCPRO image";
	#address-cells = <1>;

	images {
		kernel@1 {
			description = "CMPCPRO kernel";
			data = /incbin/("vmlinux.bin.gz");
			type = "kernel";
			arch = "ppc";
			os = "linux";
			compression = "gzip";
			load = <00000000>;
			entry = <00000000>;
			hash@1 {
				algo = "crc32";
			};
			hash@2 {
				algo = "sha1";
			};
		};
		fdt@1 {
			description = "CMPCPRO DTB";
			data = /incbin/("arch/powerpc/boot/dts/saf3000/cmpcpro.dtb");
			type = "flat_dt";
			arch = "ppc";
			compression = "none";
			hash@1 {
				algo = "crc32";
			};
			hash@2 {
				algo = "sha1";
			};
		};
		fdt@2 {
			description = "MCRPRO DTB";
			data = /incbin/("arch/powerpc/boot/dts/saf3000/mcrpro.dtb");
			type = "flat_dt";
			arch = "ppc";
			compression = "none";
			hash@1 {
				algo = "crc32";
			};
			hash@2 {
				algo = "sha1";
			};
		};
		fdt@3 {
			description = "MIAEPRO DTB";
			data = /incbin/("arch/powerpc/boot/dts/saf3000/miaepro.dtb");
			type = "flat_dt";
			arch = "ppc";
			compression = "none";
			hash@1 {
				algo = "crc32";
			};
			hash@2 {
				algo = "sha1";
			};
		};
	};

	configurations {
		default = "cmpcpro";
		cmpcpro {
			description = "CMPCPRO configuration";
			kernel = "kernel@1";
			fdt = "fdt@1";
		};
		mcrpro {
			description = "MCRPRO configuration";
			kernel = "kernel@1";
			fdt = "fdt@2";
		};
		miaepro {
			description = "MIAEPRO configuration";
			kernel = "kernel@1";
			fdt = "fdt@3";
		};
	};
};
```

## drivers/net/wan/framer/Kconfig
```kconfig
# SPDX-License-Identifier: GPL-2.0-only
#
# FRAMER
#

menu "Framer Subsystem"

config GENERIC_FRAMER
	bool "Framer Core"
	help
	  Generic Framer support.

	  This framework is designed to provide a generic interface for framer
	  devices present in the kernel. This layer will have the generic
	  API by which framer drivers can create framer using the framer
	  framework and framer users can obtain reference to the framer.
	  All the users of this framework should select this config.

endmenu
```

## drivers/platform/Kconfig
```kconfig
# SPDX-License-Identifier: GPL-2.0-only

source "drivers/platform/saf3000/Kconfig"

if X86
source "drivers/platform/x86/Kconfig"
endif
if MIPS
source "drivers/platform/mips/Kconfig"
endif

source "drivers/platform/goldfish/Kconfig"

source "drivers/platform/chrome/Kconfig"

source "drivers/platform/mellanox/Kconfig"

source "drivers/platform/olpc/Kconfig"

source "drivers/platform/surface/Kconfig"
```
